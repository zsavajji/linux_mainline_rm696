## drivers/media/i2c/nokia-camera/Kconfig
```kconfig
# SPDX-License-Identifier: GPL-2.0-only
config VIDEO_NOKIA_SMIAPP
	tristate "Nokia N9 cameras: Harmattan's SMIA/SMIA++ driver"
	depends on I2C && VIDEO_DEV && OF && COMMON_CLK && !64BIT
	select MEDIA_CONTROLLER
	select VIDEO_V4L2_SUBDEV_API
	select V4L2_FWNODE
	help
	  Nokia's driver for the N9's main and front camera modules, as Harmattan's camera
	  userspace expects it: the sensor modes come from Nokia's register-list firmware
	  (smiapp-sensor-*.bin, smia-sensor-*.bin), the subdev names, controls and sysfs
	  files are stock's. Also the N9's camera board glue.

config VIDEO_NOKIA_AD58XX
	tristate "Nokia N9 cameras: Harmattan's AD58xx lens driver"
	depends on VIDEO_NOKIA_SMIAPP
	help
	  Nokia's driver for the voice coil lens actuator of the N9's main camera.

config VIDEO_NOKIA_AS3645A
	tristate "Nokia N9 cameras: Harmattan's AS3645A flash driver"
	depends on VIDEO_NOKIA_SMIAPP && !LEDS_AS3645A
	help
	  Nokia's V4L2 subdev driver for the N9's camera flash and its indicator LED, as
	  Harmattan's camera userspace drives them.
```

## drivers/net/wireless/ti/wl1271/Kconfig
```kconfig
# SPDX-License-Identifier: GPL-2.0-only
config WL1271_NOKIA
	tristate "TI wl1271/wl1273 with Nokia's 6.1 firmware (Nokia N9)"
	depends on MAC80211 && WLCORE=n
	select FW_LOADER
	help
	  Nokia's N9 driver for its TI WL1273 (the 2.6.37/38 wl12xx with Nokia's
	  changes), ported: it runs the N9's own firmware (/lib/firmware/wl1271-fw.bin,
	  6.1.1.39.339) and takes Harmattan's NVS push. wlcore can't drive that
	  firmware, and linux-firmware's for wlcore idles far higher on 5 GHz.

	  The module is called wl12xx, as on the N9.

config WL1271_NOKIA_SDIO
	tristate "Nokia N9 WL1273 on SDIO"
	depends on WL1271_NOKIA && MMC
	help
	  The SDIO glue of WL1271_NOKIA. The module is called wl12xx_sdio, as on the N9.
```

## security/aegis/creds/Kconfig
```kconfig
config SECURITY_AEGIS_CREDS
	bool "Credentials retrieval"
	depends on SECURITY_AEGIS
	default n
	help
	  This selects the Credentials Retrieval module, which
	  provides the task credentials information for the
	  user space applications.
	  This is part of Maemo Aegis Security framework.
	  If you are unsure how to answer this question, answer N.
```
